## src/drivers/rotor_encoder/Kconfig
```kconfig
menuconfig DRIVERS_ROTOR_ENCODER
	bool "rotor_encoder"
	default n
	---help---
		Optical rotor azimuth encoder (slot and index tracks on FMU capture pins) to rotor_azimuth
		for coax_mixer (aperocopter)
```

## src/modules/coax_mixer/Kconfig
```kconfig
menuconfig MODULES_COAX_MIXER
	bool "coax_mixer"
	default n
	---help---
		Coaxial per-blade tip-flap mixer (aperocopter): thrust/torque setpoints to 1 motor + 4 flap servos
```
